## conf/layer.conf
```bitbake
# We have a conf and classes directory, add to BBPATH
BBPATH .= ":${LAYERDIR}"

# We have recipes-* directories, add to BBFILES
BBFILES += "${LAYERDIR}/recipes-*/*/*.bb \
            ${LAYERDIR}/recipes-*/*/*.bbappend"

BBFILE_COLLECTIONS += "meta-dashboard"
BBFILE_PATTERN_meta-dashboard = "^${LAYERDIR}/"
BBFILE_PRIORITY_meta-dashboard = "6"

LAYERDEPENDS_meta-dashboard = "core"
LAYERSERIES_COMPAT_meta-dashboard = "scarthgap"
```

## wic/dashboard-image.wks
```
# Simple single-partition image for qemuarm
part / --source rootfs --ondisk sda --fstype=ext4 --label root --align 1024 --size 512M
```
